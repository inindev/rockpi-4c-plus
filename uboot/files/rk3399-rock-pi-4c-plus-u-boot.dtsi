// SPDX-License-Identifier: GPL-2.0+
/*
 * Copyright (C) 2022 John Clark <inindev@gmail.com>
 */

#include "rk3399-u-boot.dtsi"
#include "rk3399-sdram-lpddr4-100.dtsi"

/ {
	chosen {
		u-boot,spl-boot-order = "same-as-spl", &sdhci, &sdmmc;
	};

	config {
		// location of u-boot.itb in spi flash
		u-boot,spl-payload-offset = <0x200000>;
	};
};

&spi_flash {
	u-boot,dm-pre-reloc;
};
